## Other/Kconfig/基于Python的Kconfig/config.in
```kconfig
mainmenu "My Kconfig Demo"

menu "Main"
config CONFIG_DEBUG
    bool "Enable debug"
    default n
    help
        Will print debug information if enable.

config CONFIG_DEBUG_UART
    bool "Enable UART debug"
    default n
    depends on CONFIG_DEBUG

source src/fs/config.in

endmenu
```

## Other/Kconfig/基于Python的Kconfig/src/fs/config.in
```kconfig
config USING_FS
    bool "USING FS"
    default n
    help
        Will print debug information if enable.
```
